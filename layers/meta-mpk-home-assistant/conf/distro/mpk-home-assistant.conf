## layers/meta-mpk-home-assistant/conf/distro/mpk-home-assistant.conf
```bitbake
DISTRO = "mpk-home-assistant"
DISTRO_NAME = "MPK Home Assistant Demo/Test Distro"
DISTRO_VERSION_BASE = "4.0.4"
DISTRO_VERSION = "${DISTRO_VERSION_BASE}+snapshot-${DATE}"
DISTRO_CODENAME = "kirkstone"
SDK_VENDOR = "-mpkhasdk"
SDK_VERSION := "${@'${DISTRO_VERSION}'.replace('snapshot-${DATE}','snapshot')}"

MAINTAINER = "Marc Kelly <marcpkelly@gmail.com>"

TARGET_VENDOR = "-mpkha"

# New ${DISTRO}-<version> setting for sanity checks.
# Increment version number (and the corresponding
# setting int the template bblayers.conf.sample file)
# each time the layer settings are changed.
REQUIRED_HA_BBLAYERS_CONF_VERSION = "${DISTRO}-4"

LOCALCONF_VERSION = "2"

DISTRO_VERSION[vardepsexclude] = "DATE"
SDK_VERSION[vardepsexclude] = "DATE"

HA_DEFAULT_DISTRO_FEATURES = "largefile opengl ptest multiarch wayland vulkan systemd pam virtualization"

DISTRO_FEATURES ?= "${DISTRO_FEATURES_DEFAULT} ${HA_DEFAULT_DISTRO_FEATURES}"

SDK_NAME = "${DISTRO}-${TCLIBC}-${SDKMACHINE}-${IMAGE_BASENAME}-${TUNE_PKGARCH}-${MACHINE}"
SDKPATH = "/opt/${DISTRO}/${SDK_VERSION}"

TCLIBCAPPEND = ""

PREMIRRORS ??= "\
bzr://.*/.*   http://downloads.yoctoproject.org/mirror/sources/ \
cvs://.*/.*   http://downloads.yoctoproject.org/mirror/sources/ \
git://.*/.*   http://downloads.yoctoproject.org/mirror/sources/ \
gitsm://.*/.* http://downloads.yoctoproject.org/mirror/sources/ \
hg://.*/.*    http://downloads.yoctoproject.org/mirror/sources/ \
osc://.*/.*   http://downloads.yoctoproject.org/mirror/sources/ \
p4://.*/.*    http://downloads.yoctoproject.org/mirror/sources/ \
svn://.*/.*   http://downloads.yoctoproject.org/mirror/sources/"

SANITY_TESTED_DISTROS ?= " \
            ubuntu-18.04 \n \
            ubuntu-20.04 \n \
            ubuntu-21.10 \n \
            ubuntu-22.04 \n \
            fedora-36 \n \
            "
# Use Systemd
INIT_MANAGER = "systemd"

require conf/distro/include/no-static-libs.inc
require conf/distro/include/yocto-uninative.inc
require conf/distro/include/security_flags.inc
INHERIT += "uninative"

BB_SIGNATURE_HANDLER ?= "OEEquivHash"
BB_HASHSERVE ??= "auto"

LICENSE_FLAGS_ACCEPTED += "commercial_faad2"
```

## layers/meta-mpk-home-assistant/conf/layer.conf
```bitbake
BBPATH =. "${LAYERDIR}:"
BBFILES += "${LAYERDIR}/recipes-*/*/*.bb ${LAYERDIR}/recipes-*/*/*.bbappend"

BBFILE_COLLECTIONS += "mpk-home-assistant"
BBFILE_PATTERN_mpk-home-assistant= "^${LAYERDIR}/"
BBFILE_PRIORITY_mpk-home-assistant = "50"

LAYERVERSION_mpk-home-assistant = "4"
LAYERSERIES_COMPAT_mpk-home-assistant = "kirkstone"

# This is used by the tegra-distro-sanity bbclass
# to identify the distro layer directory during
# bblayers checks.
HA_DISTRO_LAYERDIR = "${LAYERDIR}"
```
